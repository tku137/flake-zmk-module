## boards/shields/anywhy_flake/Kconfig.defconfig
```kconfig
# Dongle configuration (central role)
if SHIELD_ANYWHY_FLAKE_DONGLE

config ZMK_KEYBOARD_NAME
    default "Flake Dongle"

config ZMK_SPLIT_ROLE_CENTRAL
    default y

config ZMK_SPLIT
    default y

config ZMK_SPLIT_BLE_CENTRAL_PERIPHERALS
    default 2

config BT_MAX_CONN
    default 7

config BT_MAX_PAIRED
    default 7

# ZMK Studio runs on the dongle (central + USB connected)
config ZMK_STUDIO
    default y

endif

# Left half configuration (peripheral only)
if SHIELD_ANYWHY_FLAKE_LEFT

config ZMK_KEYBOARD_NAME
    default "Anywhy Flake"

endif

# Both halves are peripherals in dongle setup
if SHIELD_ANYWHY_FLAKE_LEFT || SHIELD_ANYWHY_FLAKE_RIGHT

config ZMK_SPLIT
    default y

endif
```
